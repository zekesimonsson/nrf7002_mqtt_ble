## CMakeLists.txt
```
#
# Copyright (c) 2023 Nordic Semiconductor ASA
#
# SPDX-License-Identifier: LicenseRef-Nordic-5-Clause
#

cmake_minimum_required(VERSION 3.20.0)

find_package(Zephyr REQUIRED HINTS $ENV{ZEPHYR_BASE})
project(MQTT_BLE_CLIENT)

# Include files that are common for all modules
add_subdirectory(src/common)

# Include mandatory module source folders
add_subdirectory(src/modules/trigger)
add_subdirectory(src/modules/sampler)
add_subdirectory(src/modules/network)
add_subdirectory(src/modules/transport)
add_subdirectory(src/modules/error)

# Optional modules
add_subdirectory_ifdef(CONFIG_MQTT_SAMPLE_LED src/modules/led)

# NORDIC SDK APP START
target_sources(app PRIVATE src/main.c src/ble/ble_client.c)
```

## Kconfig
```
#
# Copyright (c) 2023 Nordic Semiconductor ASA
#
# SPDX-License-Identifier: LicenseRef-Nordic-5-Clause
#

menu "MQTT sample"

config MQTT_SAMPLE_PAYLOAD_CHANNEL_STRING_MAX_SIZE
	int "Payload maximum string size"
	default 100
	help
	  Maximum size of the string included messages that are sent over the payload channel.

config MQTT_BROKER_USERNAME
    string "MQTT Broker Username"
    help
      Specifies the username used to connect to the MQTT broker.

config MQTT_BROKER_PASSWORD
    string "MQTT Broker Password"
    help
      Specifies the password used to connect to the MQTT broker.

rsource "src/modules/trigger/Kconfig.trigger"
rsource "src/modules/sampler/Kconfig.sampler"
rsource "src/modules/network/Kconfig.network"
rsource "src/modules/transport/Kconfig.transport"
rsource "src/modules/error/Kconfig.error"
rsource "src/modules/led/Kconfig.led"

endmenu

menu "Zephyr Kernel"
source "Kconfig.zephyr"
endmenu
```

## prj.conf
```kconfig
#
# Copyright (c) 2023 Nordic Semiconductor ASA
#
# SPDX-License-Identifier: LicenseRef-Nordic-5-Clause
#

# Common configurations for all boards

# General
CONFIG_HW_ID_LIBRARY=y
CONFIG_ASSERT=y

# Logging
CONFIG_LOG=y

# Networking
CONFIG_NETWORKING=y
CONFIG_NET_SOCKETS=y
CONFIG_POSIX_API=y
CONFIG_NET_IPV4=y
CONFIG_NET_TCP=y
CONFIG_NET_NATIVE=y
CONFIG_NET_CONNECTION_MANAGER=y

# ZBus
CONFIG_ZBUS=y

# Zephyr state framework
CONFIG_SMF=y

# MQTT
CONFIG_MQTT_HELPER=y
CONFIG_MQTT_CLEAN_SESSION=y

CONFIG_MQTT_SAMPLE_TRANSPORT_BROKER_HOSTNAME="52.158.45.143"
CONFIG_MQTT_SAMPLE_TRANSPORT_CLIENT_ID="simonsson"
CONFIG_MQTT_SAMPLE_TRANSPORT_PUBLISH_TOPIC="/semcon/iot/light/johan"
CONFIG_MQTT_SAMPLE_TRANSPORT_SUBSCRIBE_TOPIC="/semcon/iot/light/value"

# Enable Bluetooth
CONFIG_BT=y
CONFIG_BT_OBSERVER=y
CONFIG_BT_CENTRAL=y
CONFIG_BT_SCAN=y
CONFIG_BT_GATT_DM=y
CONFIG_BT_GATT_CLIENT=y

# Enable BLE stack logging (optional, for debugging)
CONFIG_BT_DEBUG_LOG=y
```

## boards/nrf7002dk_nrf5340_cpuapp_ns.conf
```kconfig
#
# Copyright (c) 2023 Nordic Semiconductor ASA
#
# SPDX-License-Identifier: LicenseRef-Nordic-5-Clause
#

# Configuration file for nRF7002 DK
# This file is merged with prj.conf in the application folder, and options
# set here will take precedence if they are present in both files.

# General
CONFIG_POSIX_CLOCK=y
CONFIG_SYSTEM_WORKQUEUE_STACK_SIZE=4096
CONFIG_MAIN_STACK_SIZE=2048
CONFIG_LOG_BUFFER_SIZE=3072
CONFIG_HEAP_MEM_POOL_SIZE=81920
CONFIG_HW_STACK_PROTECTION=y
CONFIG_HW_ID_LIBRARY_SOURCE_NET_MAC=y
CONFIG_DK_LIBRARY=y

# Optimize Wi-Fi stack to save some memory
CONFIG_NRF700X_RX_NUM_BUFS=16
CONFIG_NRF700X_MAX_TX_AGGREGATION=4

# Wi-Fi
CONFIG_WIFI=y
CONFIG_WIFI_NRF700X=y
CONFIG_WIFI_NRF700X_LOG_LEVEL_ERR=y
CONFIG_WIFI_MGMT_EXT=y
CONFIG_WIFI_CREDENTIALS=y

# Shell
CONFIG_SHELL=y
CONFIG_SHELL_STACK_SIZE=6144

# Zephyr NET Connection Manager Connectivity layer.
CONFIG_L2_WIFI_CONNECTIVITY=y
CONFIG_L2_WIFI_CONNECTIVITY_AUTO_CONNECT=n
CONFIG_L2_WIFI_CONNECTIVITY_AUTO_DOWN=n

# WPA
CONFIG_WPA_SUPP=y
CONFIG_WPA_SUPP_LOG_LEVEL_ERR=y
CONFIG_MBEDTLS_HEAP_SIZE=16384

# NET sockets
CONFIG_NET_L2_ETHERNET=y
CONFIG_NET_UDP=y
CONFIG_NET_SOCKETS_OFFLOAD=n
CONFIG_NET_DHCPV4=y
CONFIG_NET_CONTEXT_SNDTIMEO=y
CONFIG_NET_L2_WIFI_SHELL=y

# DNS
CONFIG_DNS_RESOLVER=y
CONFIG_NET_SOCKETS_DNS_TIMEOUT=30000

# Optimize TF-M
CONFIG_TFM_PROFILE_TYPE_SMALL=y
CONFIG_PM_PARTITION_SIZE_TFM_SRAM=0xc000
CONFIG_PM_PARTITION_SIZE_TFM=0x20000

CONFIG_MQTT_BROKER_USERNAME="semcon"
CONFIG_MQTT_BROKER_PASSWORD="iot_cop123!"
```

## src/main.c
```c
#include "ble/ble_client.h"

void main(void) {
    // Initialize BLE
    ble_init();

    // Start BLE scanning
    start_scan();

    // Proceed with MQTT functionality...
}
```
